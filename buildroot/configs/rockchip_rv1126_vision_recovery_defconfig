## buildroot/configs/rockchip_rv1126_vision_recovery_defconfig
```kconfig
#include "base.config"
#include "base_extra.config"
#include "rv1126_rv1109_arm.config"
#include "recovery.config"
BR2_TOOLCHAIN_EXTERNAL_DOWNLOAD=y
BR2_TOOLCHAIN_EXTERNAL_URL="https://armkeil.blob.core.windows.net/developer/Files/downloads/gnu-a/8.3-2019.03/binrel/gcc-arm-8.3-2019.03-x86_64-arm-linux-gnueabihf.tar.xz"
BR2_TARGET_GENERIC_ROOT_PASSWD="123qwe"
BR2_ROOTFS_OVERLAY="board/rockchip/rv1126_rv1109/fs-overlay-recovery/"
```

## buildroot/package/firefly/Config.in
```kconfig
source "package/firefly/arcface/Config.in"
source "package/firefly/arcuvc/Config.in"
source "package/firefly/rkaiq_switch_mode/Config.in"
source "package/firefly/firefly_rkmedia_demo/Config.in"
source "package/firefly/firefly_rkmedia_uvc/Config.in"
source "package/firefly/firefly_rockx_demo/Config.in"
source "package/firefly/xhlpr_app/Config.in"
```

## buildroot/package/firefly/firefly_rkmedia_demo/Config.in
```kconfig
config BR2_PACKAGE_FIREFLY_RKMEDIA_DEMO
    bool "Firefly Rkmedia Demo"
    help
        Provided by Firefly
```

## buildroot/package/firefly/firefly_rkmedia_uvc/Config.in
```kconfig
config BR2_PACKAGE_FIREFLY_RKMEDIA_UVC
    bool "Firefly Rkmedia UVC"
    help
        Provided by Firefly
```

## buildroot/package/firefly/firefly_rockx_demo/Config.in
```kconfig
config BR2_PACKAGE_FIREFLY_ROCKX_DEMO
    bool "Firefly Rockx Demo"
    help
        Provided by Firefly
```

## buildroot/package/firefly/rkaiq_switch_mode/Config.in
```kconfig
config BR2_PACKAGE_RKAIQ_SWITCH_MODE
    bool "rkaiq switch mode"
    help
        Provided by firefly
```

## buildroot/package/firefly/xhlpr_app/Config.in
```kconfig
config BR2_PACKAGE_XHLPR_APP
    bool "Xhlpr App"
    help
        Provided by Firefly
```

## buildroot/package/vision-app/Config.in
```kconfig
menuconfig BR2_PACKAGE_VISION_APP
	bool "VISION packages"
	# select BR2_PACKAGE_HOST_E2FSPROGS
	# select BR2_PACKAGE_HOST_NTFS_3G

if BR2_PACKAGE_VISION_APP



# Packages 
source "package/vision-app/msp2udp/Config.in"
source "package/vision-app/msp-service/Config.in"
source "package/vision-app/wfb-ng/Config.in"
source "package/vision-app/vision-initd/Config.in"
source "package/vision-app/vision-services/Config.in"
endif
```

## buildroot/package/vision-app/msp-service/Config.in
```kconfig
config BR2_PACKAGE_MSP_SERVICE
	bool "msp-service"
	help
	  msp service, Multiwii serial protocol service
```

## buildroot/package/vision-app/msp2udp/Config.in
```kconfig
config BR2_PACKAGE_MSP2UDP
	bool "msp2osd"
	help
	  msp server, transmit MSP package to UDP port
```

## buildroot/package/vision-app/vision-initd/Config.in
```kconfig
# config BR2_PACKAGE_VISION_INITD
# 	bool "initd scripts"
# 	help
# 		Start up initd scripts


# menu "Configuration"
# 	depends on BR2_PACKAGE_VISION_INITD

# config BR2_PACKAGE_VISION_INITD_MSP_SERVICE
# 	bool "msp service"
# 	depends on BR2_PACKAGE_MSP_SERVICE
# 	default n

# config BR2_PACKAGE_WFB_NG_RX	
# 	bool "wfb-ng rx"
# 	depends on BR2_PACKAGE_WFB_NG
# 	default n

# config BR2_PACKAGE_WFB_NG_KEYGEN	
# 	bool "wfb-ng keygen"
# 	depends on BR2_PACKAGE_WFB_NG
# 	default n	

# config BR2_PACKAGE_WFB_NG_KEYS
# 	bool "pre-generated keys"
# 	depends on BR2_PACKAGE_WFB_NG
# 	default n	

# endmenu

# config BR2_PACKAGE_VISION_INITD
# 	bool "vision initd startup scripts"
# 	select CONFIG_VISION_INITD
# 	default n

menuconfig CONFIG_VISION_INITD
	bool "initd startup scripts"
	select BR2_PACKAGE_VISION_INITD
	#default y
	help
	  Start up initd scripts

if CONFIG_VISION_INITD

config BR2_PACKAGE_VISION_INITD_MSP_SERVICE
	bool "msp service"
	depends on BR2_PACKAGE_MSP_SERVICE
	default n

config BR2_PACKAGE_VISION_INITD_MSP2UDP
	bool "msp to udp bridge"
	depends on BR2_PACKAGE_MSP2UDP
	default n

endif # SAMPLES
```

## buildroot/package/vision-app/wfb-ng/Config.in
```kconfig
config BR2_PACKAGE_WFB_NG
	bool "wfb-ng"
	help
		This is the next generation of long-range packet radio link based on raw WiFi radio

		https://github.com/svpcom/wfb-ng

menu "Configuration"
	depends on BR2_PACKAGE_WFB_NG

config BR2_PACKAGE_WFB_NG_TX
	bool "wfb-ng tx"
	depends on BR2_PACKAGE_WFB_NG
	default y

config BR2_PACKAGE_WFB_NG_RX	
	bool "wfb-ng rx"
	depends on BR2_PACKAGE_WFB_NG
	default n

config BR2_PACKAGE_WFB_NG_KEYGEN	
	bool "wfb-ng keygen"
	depends on BR2_PACKAGE_WFB_NG
	default n	

config BR2_PACKAGE_WFB_NG_KEYS
	bool "pre-generated keys"
	depends on BR2_PACKAGE_WFB_NG
	default n	

endmenu
```

## u-boot/fit/u-boot.its
```
/*
 * Copyright (C) 2020 Rockchip Electronic Co.,Ltd
 *
 * Simple U-boot fit source file containing U-Boot, dtb and optee
 */

/dts-v1/;

/ {
	description = "FIT Image with U-Boot/OP-TEE/MCU";
	#address-cells = <1>;

	images {
		uboot {
			description = "U-Boot (32-bit)";
			data = /incbin/("./u-boot-nodtb.bin.gz");
			type = "standalone";
			arch = "arm";
			os = "U-Boot";
			compression = "gzip";
			load = <0x00400000>;
			hash {
				algo = "sha256";
			};
			digest {
				value = /incbin/("./u-boot-nodtb.digest");
				algo = "sha256";
			};
		};
		optee {
			description = "OP-TEE";
			data = /incbin/("./tee.bin.gz");
			type = "firmware";
			arch = "arm";
			os = "op-tee";
			compression = "gzip";
			load = <0x8400000>;
			entry = <0x8400000>;
			hash {
				algo = "sha256";
			};
			digest {
				value = /incbin/("./tee.digest");
				algo = "sha256";
			};
		};
		fdt {
			description = "U-Boot dtb";
			data = /incbin/("./u-boot.dtb");
			type = "flat_dt";
			arch = "arm";
			compression = "none";
			hash {
				algo = "sha256";
			};
		};


	};

	configurations {
		default = "conf";
		conf {
			description = "rv1126-evb";
			rollback-index = <0x0>;
			firmware = "optee";
			loadables = "uboot";
			fdt = "fdt";

			signature {
				algo = "sha256,rsa2048";
				
				key-name-hint = "dev";
			        sign-images = "fdt", "firmware", "loadables";
			};
		};
	};
};
```
